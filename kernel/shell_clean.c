#include <stdio.h>
#include <stdlib.h>
#include <string.h>
#include <time.h>
#include <sys/time.h>
#include "freertos/FreeRTOS.h"
#include "freertos/task.h"
#include "esp_system.h"
#include "esp_chip_info.h"
#include "esp_heap_caps.h"
#include "esp_log.h"
#include "esp_wifi.h"
#include "esp_event.h"
#include "esp_flash.h"
#include "nvs_flash.h"
#include "lwip/err.h"
#include "lwip/netdb.h"
#include "shell.h"
#include "display_st7789.h"
#include "process.h"
#include "vfs.h"

/* ---- 鍛戒护琛?---- */
typedef struct {
    const char *name;
    const char *desc;
    const char *usage;
    void (*handler)(shell_t *sh, int argc, char **argv);
} cmd_entry_t;

static void cmd_help(shell_t *sh, int argc, char **argv);
static void cmd_ls(shell_t *sh, int argc, char **argv);
static void cmd_cat(shell_t *sh, int argc, char **argv);
static void cmd_cd(shell_t *sh, int argc, char **argv);
static void cmd_pwd(shell_t *sh, int argc, char **argv);
static void cmd_mkdir(shell_t *sh, int argc, char **argv);
static void cmd_rm(shell_t *sh, int argc, char **argv);
static void cmd_clear(shell_t *sh, int argc, char **argv);
static void cmd_ps(shell_t *sh, int argc, char **argv);
static void cmd_reboot(shell_t *sh, int argc, char **argv);
static void cmd_touch(shell_t *sh, int argc, char **argv);
static void cmd_write(shell_t *sh, int argc, char **argv);
static void cmd_mv(shell_t *sh, int argc, char **argv);
static void cmd_cp(shell_t *sh, int argc, char **argv);
static void cmd_exec(shell_t *sh, int argc, char **argv);
static void cmd_kill(shell_t *sh, int argc, char **argv);
static void cmd_wifi(shell_t *sh, int argc, char **argv);
static void cmd_sysinfo(shell_t *sh, int argc, char **argv);

static const cmd_entry_t cmd_table[] = {
    {"help",   "鏄剧ず甯姪淇℃伅",        "help [鍛戒护]", cmd_help},
    {"ls",     "鍒楀嚭鐩綍鍐呭",        "ls [-l] [璺緞]", cmd_ls},
    {"cat",    "鏄剧ず鏂囦欢鍐呭",        "cat <鏂囦欢>", cmd_cat},
    {"cd",     "鍒囨崲褰撳墠鐩綍",        "cd <璺緞>", cmd_cd},
    {"pwd",    "鏄剧ず褰撳墠鐩綍",        "pwd", cmd_pwd},
    {"mkdir",  "鍒涘缓鐩綍",           "mkdir <鐩綍鍚?", cmd_mkdir},
    {"rm",     "鍒犻櫎鏂囦欢鎴栫洰褰?,      "rm [-r] <璺緞>", cmd_rm},
    {"clear",  "娓呭睆",              "clear", cmd_clear},
    {"ps",     "鏄剧ず杩涚▼淇℃伅",        "ps", cmd_ps},
    {"reboot", "閲嶅惎绯荤粺",           "reboot", cmd_reboot},
    {"touch",  "鍒涘缓绌烘枃浠?,         "touch <鏂囦欢>", cmd_touch},
    {"write",  "鍐欏叆鏂囦欢",           "write <鏂囦欢> <鍐呭>", cmd_write},
    {"exec",   "杩愯ELF绋嬪簭",        "exec <ELF鏂囦欢>", cmd_exec},
    {"mv",     "绉诲姩/閲嶅懡鍚嶆枃浠?,     "mv <婧? <鐩爣>", cmd_mv},
    {"cp",     "澶嶅埗鏂囦欢",           "cp <婧? <鐩爣>", cmd_cp},
    {"kill",   "缁堟杩涚▼",           "kill <PID>", cmd_kill},
    {"wifi",   "杩炴帴WiFi缃戠粶",        "wifi <ssid> <password>", cmd_wifi},
    {"sysinfo","鏄剧ず绯荤粺璧勬簮",        "sysinfo", cmd_sysinfo},
    {NULL, NULL, NULL, NULL}
};

/* ---- ELF/杩涚▼鍛戒护 ---- */
static void cmd_exec(shell_t *sh, int argc, char **argv)
{
    if (argc < 2) { term_puts(sh->term, "鐢ㄦ硶: exec <ELF鏂囦欢>\n"); return; }
    term_puts(sh->term, "姝ｅ湪鍔犺浇: ");
    term_puts(sh->term, argv[1]);
    term_puts(sh->term, "\n");
    int pid = proc_spawn_elf(argv[1], argc - 1, argv + 1);
    if (pid < 0) {
        term_puts(sh->term, "鍔犺浇澶辫触\n");
        return;
    }
    char buf[64];
    snprintf(buf, sizeof(buf), "PID=%d running, wait...\n", pid);
    term_puts(sh->term, buf);
    int code;
    uint16_t done = proc_wait_any(&code);
    snprintf(buf, sizeof(buf), "PID=%d exit (code=%d)\n", done, code);
    term_puts(sh->term, buf);
}

static void cmd_kill(shell_t *sh, int argc, char **argv)
{
    if (argc < 2) { term_puts(sh->term, "鐢ㄦ硶: kill <PID>\n"); return; }
    int pid = atoi(argv[1]);
    if (proc_kill(pid) == 0)
        term_puts(sh->term, "宸茬粓姝n");
    else
        term_puts(sh->term, "杩涚▼涓嶅瓨鍦╘n");
}

/* ---- 鍛戒护瀹炵幇 ---- */

static void cmd_help(shell_t *sh, int argc, char **argv)
{
    term_puts(sh->term, "\nOpenCrab - 鍙敤鍛戒护:\n");
    term_puts(sh->term, "================================\n");

    if (argc > 1) {
        for (int i = 0; cmd_table[i].name; i++) {
            if (strcmp(argv[1], cmd_table[i].name) == 0) {
                term_puts(sh->term, cmd_table[i].name);
                term_puts(sh->term, " - ");
                term_puts(sh->term, cmd_table[i].desc);
                term_puts(sh->term, "\n  鐢ㄦ硶: ");
                term_puts(sh->term, cmd_table[i].usage);
                term_puts(sh->term, "\n");
                return;
            }
        }
        term_puts(sh->term, "鏈煡鍛戒护: ");
        term_puts(sh->term, argv[1]);
        term_puts(sh->term, "\n");
        return;
    }

    for (int i = 0; cmd_table[i].name; i++) {
        term_puts(sh->term, "  ");
        term_puts(sh->term, cmd_table[i].name);
        int pad = 10 - strlen(cmd_table[i].name);
        if (pad < 1) pad = 1;
        char buf[16];
        memset(buf, ' ', pad);
        buf[pad] = '\0';
        term_puts(sh->term, buf);
        term_puts(sh->term, cmd_table[i].desc);
        term_puts(sh->term, "\n");
    }
}

static void cmd_ls(shell_t *sh, int argc, char **argv)
{
    const char *path = (argc > 1) ? argv[1] : ".";
    int long_format = 0;

    if (argc > 1 && strcmp(argv[1], "-l") == 0) {
        long_format = 1;
        path = (argc > 2) ? argv[2] : ".";
    }

    vfs_dir_t *dir = vfs_opendir(path);
    if (!dir) {
        term_puts(sh->term, "鏃犳硶鎵撳紑鐩綍: ");
        term_puts(sh->term, path);
        term_puts(sh->term, "\n");
        return;
    }

    vfs_dirent_t *entry;
    while ((entry = vfs_readdir(dir)) != NULL) {
        if (!long_format) {
            term_puts(sh->term, entry->name);
            term_puts(sh->term, "  ");
        } else {
            term_puts(sh->term, entry->type == VFS_DIR ? "d" : "-");
            term_puts(sh->term, "rw-r--r-- ");
            char size_str[16];
            snprintf(size_str, sizeof(size_str), "%8lu ", (unsigned long)entry->size);
            term_puts(sh->term, size_str);
            term_puts(sh->term, entry->name);
            term_puts(sh->term, "\n");
        }
    }

    if (!long_format) {
        term_puts(sh->term, "\n");
    }

    vfs_closedir(dir);
}

static void cmd_cat(shell_t *sh, int argc, char **argv)
{
    if (argc < 2) {
        term_puts(sh->term, "鐢ㄦ硶: cat <鏂囦欢>\n");
        return;
    }

    vfs_file_t *file = vfs_open(argv[1], VFS_O_RDONLY);
    if (!file) {
        term_puts(sh->term, "鏃犳硶鎵撳紑鏂囦欢: ");
        term_puts(sh->term, argv[1]);
        term_puts(sh->term, "\n");
        return;
    }

    char buf[128];
    int bytes;
    while ((bytes = vfs_read(file, buf, sizeof(buf) - 1)) > 0) {
        buf[bytes] = '\0';
        term_puts(sh->term, buf);
    }

    if (bytes < 0) {
        term_puts(sh->term, "\n璇诲彇閿欒\n");
    }

    vfs_close(file);
}

static void cmd_cd(shell_t *sh, int argc, char **argv)
{
    const char *path = (argc > 1) ? argv[1] : "/";
    if (vfs_chdir(path) != 0) {
        term_puts(sh->term, "鐩綍涓嶅瓨鍦? ");
        term_puts(sh->term, path);
        term_puts(sh->term, "\n");
        return;
    }
    vfs_getcwd(sh->cwd, sizeof(sh->cwd));
}

static void cmd_pwd(shell_t *sh, int argc, char **argv)
{
    (void)argc; (void)argv;
    term_puts(sh->term, sh->cwd);
    term_puts(sh->term, "\n");
}

static void cmd_mkdir(shell_t *sh, int argc, char **argv)
{
    if (argc < 2) {
        term_puts(sh->term, "鐢ㄦ硶: mkdir <鐩綍鍚?\n");
        return;
    }
    if (vfs_mkdir(argv[1]) != 0) {
        term_puts(sh->term, "鍒涘缓鐩綍澶辫触: ");
        term_puts(sh->term, argv[1]);
        term_puts(sh->term, "\n");
    }
}

static void cmd_rm(shell_t *sh, int argc, char **argv)
{
    if (argc < 2) {
        term_puts(sh->term, "鐢ㄦ硶: rm [-r] <璺緞>\n");
        return;
    }

    int recursive = 0;
    const char *path = argv[1];
    if (strcmp(argv[1], "-r") == 0) {
        recursive = 1;
        path = (argc > 2) ? argv[2] : NULL;
        if (!path) {
            term_puts(sh->term, "鐢ㄦ硶: rm [-r] <璺緞>\n");
            return;
        }
    }

    if (!recursive) {
        vfs_stat_t st;
        if (vfs_stat(path, &st) == 0 && st.type == VFS_DIR) {
            term_puts(sh->term, "鏄洰褰? 浣跨敤 rm -r 鍒犻櫎\n");
            return;
        }
    }

    if (vfs_remove(path) != 0) {
        term_puts(sh->term, "鍒犻櫎澶辫触: ");
        term_puts(sh->term, path);
        term_puts(sh->term, "\n");
    }
}

static void cmd_clear(shell_t *sh, int argc, char **argv)
{
    (void)argc; (void)argv;
    term_clear(sh->term);
}

static void cmd_ps(shell_t *sh, int argc, char **argv)
{
    (void)argc; (void)argv;
    term_puts(sh->term, "PID  NAME          STATE\n");
    term_puts(sh->term, "---  ------------  -----\n");

    TaskStatus_t *tasks = NULL;
    uint32_t total = uxTaskGetNumberOfTasks();
    tasks = malloc(sizeof(TaskStatus_t) * total);
    if (tasks) {
        total = uxTaskGetSystemState(tasks, total, NULL);
        for (uint32_t i = 0; i < total; i++) {
            char line[64];
            const char *state;
            switch (tasks[i].eCurrentState) {
                case eRunning:   state = "杩愯"; break;
                case eReady:     state = "灏辩华"; break;
                case eBlocked:   state = "闃诲"; break;
                case eSuspended: state = "鏆傚仠"; break;
                case eDeleted:   state = "鍒犻櫎"; break;
                default:         state = "鏈煡"; break;
            }
            snprintf(line, sizeof(line), "%-4d %-14s %s\n",
                     (int)tasks[i].xTaskNumber,
                     tasks[i].pcTaskName,
                     state);
            term_puts(sh->term, line);
        }
        free(tasks);
    }
}

static void cmd_reboot(shell_t *sh, int argc, char **argv)
{
    (void)argc; (void)argv;
    term_puts(sh->term, "绯荤粺灏嗗湪3绉掑悗閲嶅惎...\n");
    term_render(sh->term);
    vTaskDelay(pdMS_TO_TICKS(3000));
    esp_restart();
}

static void cmd_touch(shell_t *sh, int argc, char **argv)
{
    if (argc < 2) {
        term_puts(sh->term, "鐢ㄦ硶: touch <鏂囦欢>\n");
        return;
    }
    vfs_file_t *f = vfs_open(argv[1], VFS_O_WRONLY | VFS_O_CREAT);
    if (f) {
        vfs_close(f);
    } else {
        term_puts(sh->term, "鍒涘缓鏂囦欢澶辫触\n");
    }
}

static void cmd_write(shell_t *sh, int argc, char **argv)
{
    if (argc < 3) {
        term_puts(sh->term, "鐢ㄦ硶: write <鏂囦欢> <鍐呭>\n");
        return;
    }
    vfs_file_t *f = vfs_open(argv[1], VFS_O_WRONLY | VFS_O_CREAT);
    if (!f) {
        term_puts(sh->term, "鎵撳紑鏂囦欢澶辫触\n");
        return;
    }
    vfs_write(f, argv[2], strlen(argv[2]));
    vfs_close(f);
}


static void cmd_mv(shell_t *sh, int argc, char **argv)
{
    if (argc < 3) {
        term_puts(sh->term, "鐢ㄦ硶: mv <婧? <鐩爣>\n");
        return;
    }
    if (vfs_rename(argv[1], argv[2]) != 0) {
        term_puts(sh->term, "绉诲姩/閲嶅懡鍚嶅け璐n");
    }
}

static void cmd_cp(shell_t *sh, int argc, char **argv)
{
    if (argc < 3) {
        term_puts(sh->term, "鐢ㄦ硶: cp <婧? <鐩爣>\n");
        return;
    }

    vfs_file_t *src = vfs_open(argv[1], VFS_O_RDONLY);
    if (!src) {
        term_puts(sh->term, "鏃犳硶鎵撳紑婧愭枃浠禱n");
        return;
    }

    vfs_file_t *dst = vfs_open(argv[2], VFS_O_WRONLY | VFS_O_CREAT);
    if (!dst) {
        term_puts(sh->term, "鏃犳硶鍒涘缓鐩爣鏂囦欢\n");
        vfs_close(src);
        return;
    }

    char buf[256];
    int bytes;
    while ((bytes = vfs_read(src, buf, sizeof(buf))) > 0) {
        vfs_write(dst, buf, bytes);
    }

    vfs_close(src);
    vfs_close(dst);
    term_puts(sh->term, "澶嶅埗瀹屾垚\n");
}

/* ---- WiFi鍛戒护 ---- */
static void cmd_wifi(shell_t *sh, int argc, char **argv)
{
    if (argc < 2) {
        /* 鏄剧ず褰撳墠鐘舵€?*/
        wifi_ap_record_t ap;
        if (esp_wifi_sta_get_ap_info(&ap) == ESP_OK) {
            char line[128];
            snprintf(line, sizeof(line), "宸茶繛鎺? %s (rssi=%d)\n", (char *)ap.ssid, ap.rssi);
            term_puts(sh->term, line);
        } else {
            term_puts(sh->term, "鏈繛鎺? 鐢ㄦ硶: wifi <ssid> <password>\n");
        }
        return;
    }
    if (argc < 3) {
        term_puts(sh->term, "鐢ㄦ硶: wifi <ssid> <password>\n");
        return;
    }

    term_puts(sh->term, "姝ｅ湪杩炴帴WiFi...\n");
    term_render(sh->term);

    wifi_config_t wifi_config = {
        .sta = {
            .threshold.authmode = WIFI_AUTH_WPA2_PSK,
        },
    };
    strncpy((char *)wifi_config.sta.ssid, argv[1], sizeof(wifi_config.sta.ssid) - 1);
    strncpy((char *)wifi_config.sta.password, argv[2], sizeof(wifi_config.sta.password) - 1);

    esp_wifi_set_mode(WIFI_MODE_STA);
    esp_wifi_set_config(WIFI_IF_STA, &wifi_config);
    esp_wifi_start();
    esp_wifi_connect();

    /* 杩炴帴鏈熼棿闄嶄綆WiFi鏃ュ織绾у埆, 閬垮厤鍒峰睆 */
    esp_log_level_set("wifi", ESP_LOG_ERROR);
    for (int i = 0; i < 50; i++) {
        wifi_ap_record_t ap;
        if (esp_wifi_sta_get_ap_info(&ap) == ESP_OK) {
            char buf[64];
            snprintf(buf, sizeof(buf), "宸茶繛鎺? %s (rssi=%d)\n", (char *)ap.ssid, ap.rssi);
            term_puts(sh->term, buf);
            term_render(sh->term);
            return;
        }
        vTaskDelay(pdMS_TO_TICKS(200));
    }
    term_puts(sh->term, "杩炴帴瓒呮椂\n");
    term_render(sh->term);
}

/* ---- 绯荤粺璧勬簮鍛戒护 ---- */
static void cmd_sysinfo(shell_t *sh, int argc, char **argv)
{
    (void)argc; (void)argv;
    char line[128];

    /* CPU */
    esp_chip_info_t chip;
    esp_chip_info(&chip);
    uint32_t flash_sz = 0;
    esp_flash_get_size(NULL, &flash_sz);

    term_puts(sh->term, "-- CPU --\n");
    snprintf(line, sizeof(line), "ESP32-S3 rev%d  240MHz  %d鏍竆n", chip.revision, chip.cores);
    term_puts(sh->term, line);

    size_t total_int = heap_caps_get_total_size(MALLOC_CAP_INTERNAL);
    size_t free_int = heap_caps_get_free_size(MALLOC_CAP_INTERNAL);
    size_t total_psram = heap_caps_get_total_size(MALLOC_CAP_SPIRAM);
    size_t free_psram = heap_caps_get_free_size(MALLOC_CAP_SPIRAM);

    term_puts(sh->term, "-- 鍐呭瓨 (鐗囦笂512KB) --\n");
    snprintf(line, sizeof(line), "鍫? %dK/%dK (%d%%绌洪棽)\n",
             (int)(free_int / 1024), (int)(total_int / 1024),
             (int)(free_int * 100 / total_int));
    term_puts(sh->term, line);
    snprintf(line, sizeof(line), "缂撳瓨+浠ｇ爜: %dK\n", (int)((512 - (int)total_int) / 1024));
    term_puts(sh->term, line);

    /* 鏂囦欢绯荤粺 */
    uint32_t fs_total = 0, fs_used = 0;
    vfs_info(&fs_total, &fs_used);
    uint32_t fs_free = fs_total - fs_used;
    int pct = fs_total > 0 ? (int)(fs_used * 100 / fs_total) : 0;

    term_puts(sh->term, "-- 瀛樺偍 --\n");
    snprintf(line, sizeof(line), "Flash: %dMB   SPIFFS: %dKB\n",
             (int)(flash_sz / 1024 / 1024), (int)(fs_total / 1024));
    term_puts(sh->term, line);
    snprintf(line, sizeof(line), "PSRAM: %dMB\n", (int)(total_psram / 1024 / 1024));
    term_puts(sh->term, line);
    snprintf(line, sizeof(line), "SPIFFS绌洪棽: %dK/%dK (%d%%)\n",
             (int)(fs_free / 1024), (int)(fs_total / 1024), pct);
    term_puts(sh->term, line);
}

/* ---- 鍛戒护瑙ｆ瀽涓庢墽琛?---- */

static int split_command(const char *cmd, char **argv, int max_args)
{
    int argc = 0;
    const char *p = cmd;

    while (*p && argc < max_args - 1) {
        while (*p == ' ') p++;
        if (*p == '\0') break;

        if (*p == '"') {
            p++;
            int pos = 0;
            char *arg = malloc(MAX_CMD_LEN);
            if (!arg) break;
            while (*p && *p != '"' && pos < MAX_CMD_LEN - 1) {
                arg[pos++] = *p++;
            }
            arg[pos] = '\0';
            if (*p == '"') p++;
            argv[argc++] = arg;
        } else {
            int pos = 0;
            char *arg = malloc(MAX_CMD_LEN);
            if (!arg) break;
            while (*p && *p != ' ' && pos < MAX_CMD_LEN - 1) {
                arg[pos++] = *p++;
            }
            arg[pos] = '\0';
            argv[argc++] = arg;
        }
    }
    argv[argc] = NULL;
    return argc;
}

static void free_argv(char **argv, int argc)
{
    for (int i = 0; i < argc; i++) {
        free(argv[i]);
    }
}

/* 棰滆壊杈呭姪鍑芥暟 (瀹氫箟鍦ㄥ悗闈? */
static void shell_set_input_color(shell_t *sh);
static void shell_set_output_color(shell_t *sh);

void shell_execute(shell_t *sh, const char *cmd)
{
    if (!cmd || cmd[0] == '\0' || cmd[0] == '#') return;

    /* 娣诲姞鍒板巻鍙?*/
    if (sh->history_count == 0 ||
        strcmp(sh->history[(sh->history_count - 1) % SHELL_HISTORY], cmd) != 0) {
        int idx = sh->history_count % SHELL_HISTORY;
        strncpy(sh->history[idx], cmd, MAX_CMD_LEN - 1);
        sh->history_count++;
    }
    sh->history_pos = sh->history_count;

    /* 鍏堟崲琛?鎻愪氦甯︽彁绀虹棰滆壊鐨勮), 鍐嶅垏鎹负杈撳嚭棰滆壊 */
    term_puts(sh->term, "\n");
    shell_set_output_color(sh);

    /* 瑙ｆ瀽鍛戒护 */
    char *argv[MAX_ARGS];
    int argc = split_command(cmd, argv, MAX_ARGS);
    if (argc == 0) return;

    /* 鏌ユ壘骞舵墽琛?*/
    int found = 0;
    for (int i = 0; cmd_table[i].name; i++) {
        if (strcmp(argv[0], cmd_table[i].name) == 0) {
            cmd_table[i].handler(sh, argc, argv);
            found = 1;
            break;
        }
    }

    if (!found) {
        /* 灏濊瘯浠?/bin/ 鍔犺浇 ELF 鍛戒护 */
        char elf_path[128];
        snprintf(elf_path, sizeof(elf_path), "/bin/%s", argv[0]);
        vfs_stat_t st;
        if (vfs_stat(elf_path, &st) == 0 && st.type == VFS_FILE) {
            int pid = proc_spawn_elf(elf_path, argc, argv);
            if (pid > 0) {
                char buf[32];
                snprintf(buf, sizeof(buf), "PID=%d\n", pid);
                term_puts(sh->term, buf);
                int code;
                proc_wait_any(&code);
            } else {
                term_puts(sh->term, "鍔犺浇澶辫触\n");
            }
        } else {
            term_puts(sh->term, "鍛戒护鏈壘鍒? ");
            term_puts(sh->term, argv[0]);
            term_puts(sh->term, "\n");
        }
    }

    free_argv(argv, argc);
}

/* 璁剧疆鎻愮ず绗?杈撳叆棰滆壊 (娴呰摑) */
static void shell_set_input_color(shell_t *sh)
{
    sh->term->fg_color = 8;
    sh->term->fg_custom = COLOR_LIGHT_BLUE;
    sh->term->line_fg_color[sh->term->current_line] = COLOR_LIGHT_BLUE;
}

/* 璁剧疆杈撳嚭棰滆壊 (娴呯伆) */
static void shell_set_output_color(shell_t *sh)
{
    sh->term->fg_color = 8;
    sh->term->fg_custom = 0xC618;
    sh->term->line_fg_color[sh->term->current_line] = 0xC618;
}

/* ---- 琛岀紪杈?---- */

void shell_print_prompt(shell_t *sh)
{
    shell_set_input_color(sh);
    term_puts(sh->term, SHELL_PROMPT);
    sh->prompt_len = strlen(SHELL_PROMPT);
    sh->prompt_len *= 6;
}

static void shell_redraw_input(shell_t *sh)
{
    term_clear_line(sh->term);

    shell_set_input_color(sh);
    term_puts(sh->term, SHELL_PROMPT);
    sh->prompt_len = strlen(SHELL_PROMPT) * 6;

    for (int i = 0; i < sh->input_len; i++) {
        term_putchar(sh->term, sh->input_buf[i]);
    }
}

void shell_init(shell_t *sh, terminal_t *term)
{
    memset(sh, 0, sizeof(shell_t));
    sh->term = term;
    sh->running = 1;
    sh->history_pos = 0;
    strcpy(sh->cwd, "/");
    vfs_getcwd(sh->cwd, sizeof(sh->cwd));
}

void shell_process_char(shell_t *sh, uint16_t ch)
{
    if (ch == '\r' || ch == '\n') {
        /* 璺宠繃 CR/LF 鍙屽彂瀵艰嚧鐨勪簩娆℃墽琛?(绌鸿涓嶄骇鐢熸柊鎻愮ず绗? */
        if (sh->input_len == 0) return;

        sh->input_buf[sh->input_len] = '\0';

        /* 杞负UTF-8瀛楃涓?*/
        char utf8_cmd[MAX_CMD_LEN];
        int pos = 0;
        for (int i = 0; i < sh->input_len && pos < MAX_CMD_LEN - 4; i++) {
            uint16_t c = sh->input_buf[i];
            if (c < 0x80) {
                utf8_cmd[pos++] = (char)c;
            } else if (c < 0x800) {
                utf8_cmd[pos++] = 0xC0 | (c >> 6);
                utf8_cmd[pos++] = 0x80 | (c & 0x3F);
            } else {
                utf8_cmd[pos++] = 0xE0 | (c >> 12);
                utf8_cmd[pos++] = 0x80 | ((c >> 6) & 0x3F);
                utf8_cmd[pos++] = 0x80 | (c & 0x3F);
            }
        }
        utf8_cmd[pos] = '\0';

        shell_execute(sh, utf8_cmd);

        /* 閲嶇疆杈撳叆 */
        sh->input_len = 0;
        sh->input_cursor = 0;

        /* 鎵撳嵃鎻愮ず绗?*/
        shell_print_prompt(sh);
        term_render(sh->term);
        return;
    }

    if (ch == '\b' || ch == 0x7F) {
        if (sh->input_len > 0) {
            sh->input_len--;
            sh->input_cursor = sh->input_len;
            shell_redraw_input(sh);
            term_render(sh->term);
        }
        return;
    }

    /* 澶勭悊鐗规畩閿?(閫氳繃杞箟搴忓垪) */
    if (ch == 0x1B) {
        /* ESC搴忓垪 - 鏆備笉澶勭悊绠ご閿瓑 */
        return;
    }

    /* 杈撳叆瀛楃鏄剧ず涓鸿摑鑹插苟鍥炴樉 */
    if (sh->input_len < MAX_CMD_LEN - 1) {
        shell_set_input_color(sh);
        term_putchar(sh->term, ch);
        sh->input_buf[sh->input_len++] = ch;
        sh->input_cursor = sh->input_len;
    }

    term_render(sh->term);
}
